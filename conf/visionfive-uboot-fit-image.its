## conf/visionfive-uboot-fit-image.its
```
/dts-v1/;

/ {
        description = "U-boot FIT image for visionfive Nvdla";
        #address-cells = <2>;

        images {
                vmlinux {
                        description = "vmlinux";
                        data = /incbin/("../work/linux/arch/riscv/boot/Image");
                        type = "kernel";
                        arch = "riscv";
                        os = "linux";
                        load = <0x0 0x80200000>;
                        entry = <0x0 0x80200000>;
                        compression = "none";
                };

                fdt {
                        data = /incbin/("../work/linux/arch/riscv/boot/dts/starfive/jh7100-starfive-visionfive-v1.dtb");
                        type = "flat_dt";
                        arch = "riscv";
                        load = <0x0 0x86000000>;
                        compression = "none";
                        hash-1 {
                                algo = "sha256";
                        };
                };
        };

        configurations {
                default = "config-1";

                config-1 {
                        description = "visionfive Nvdla with opensbi";
			            kernel = "vmlinux";
                        fdt = "fdt";
                };
        };
};
```

## conf/visionfive_defconfig
```kconfig
CONFIG_LOCALVERSION="-visionfive"
CONFIG_SYSVIPC=y
# CONFIG_CROSS_MEMORY_ATTACH is not set
CONFIG_NO_HZ_IDLE=y
CONFIG_HIGH_RES_TIMERS=y
CONFIG_BPF_SYSCALL=y
CONFIG_PSI=y
CONFIG_IKCONFIG=y
CONFIG_IKCONFIG_PROC=y
CONFIG_CGROUPS=y
CONFIG_CGROUP_SCHED=y
CONFIG_CFS_BANDWIDTH=y
CONFIG_CGROUP_PIDS=y
CONFIG_CGROUP_CPUACCT=y
CONFIG_NAMESPACES=y
CONFIG_BLK_DEV_INITRD=y
CONFIG_INITRAMFS_FORCE=y
# CONFIG_RD_BZIP2 is not set
# CONFIG_RD_LZMA is not set
# CONFIG_RD_XZ is not set
# CONFIG_RD_LZO is not set
# CONFIG_RD_LZ4 is not set
# CONFIG_RD_ZSTD is not set
CONFIG_EXPERT=y
# CONFIG_SYSFS_SYSCALL is not set
CONFIG_PERF_EVENTS=y
# CONFIG_VM_EVENT_COUNTERS is not set
# CONFIG_SLUB_DEBUG is not set
CONFIG_SHUFFLE_PAGE_ALLOCATOR=y
CONFIG_SOC_STARFIVE=y
# CONFIG_RISCV_ERRATA_ALTERNATIVE is not set
# CONFIG_RISCV_SBI_V01 is not set
CONFIG_CMDLINE="console=tty0 console=ttyS0,115200 earlycon debug stmmaceth=chain_mode:1"
CONFIG_CMDLINE_FORCE=y
CONFIG_JUMP_LABEL=y
# CONFIG_STACKPROTECTOR is not set
# CONFIG_GCC_PLUGINS is not set
CONFIG_MODULES=y
CONFIG_MODULE_UNLOAD=y
# CONFIG_BLOCK is not set
CONFIG_KSM=y
CONFIG_ZSMALLOC=y
CONFIG_DEVTMPFS=y
CONFIG_DEVTMPFS_MOUNT=y
# CONFIG_STANDALONE is not set
# CONFIG_PREVENT_FIRMWARE_BUILD is not set
CONFIG_EXTRA_FIRMWARE="regulatory.db regulatory.db.p7s brcm/brcmfmac43430-sdio.bin brcm/brcmfmac43430-sdio.clm_blob brcm/brcmfmac43430-sdio.beagle,beaglev-starlight-jh7100-r0.txt brcm/brcmfmac43430-sdio.starfive,visionfive-v1.txt"
CONFIG_EXTRA_FIRMWARE_DIR="firmware"
CONFIG_EEPROM_AT24=y
CONFIG_INPUT_EVDEV=y
# CONFIG_INPUT_KEYBOARD is not set
# CONFIG_INPUT_MOUSE is not set
# CONFIG_SERIO is not set
# CONFIG_LEGACY_PTYS is not set
# CONFIG_LDISC_AUTOLOAD is not set
CONFIG_SERIAL_8250=y
# CONFIG_SERIAL_8250_DEPRECATED_OPTIONS is not set
# CONFIG_SERIAL_8250_16550A_VARIANTS is not set
CONFIG_SERIAL_8250_CONSOLE=y
CONFIG_SERIAL_8250_DW=y
CONFIG_HW_RANDOM=y
# CONFIG_DEVMEM is not set
# CONFIG_I2C_COMPAT is not set
CONFIG_I2C_CHARDEV=y
# CONFIG_I2C_HELPER_AUTO is not set
CONFIG_I2C_DESIGNWARE_PLATFORM=y
CONFIG_GPIOLIB_FASTPATH_LIMIT=256
CONFIG_GPIO_SYSFS=y
CONFIG_GPIO_TPS65086=y
# CONFIG_HWMON is not set
CONFIG_MFD_SYSCON=y
CONFIG_MFD_TPS65086=y
CONFIG_DRM=y
CONFIG_DRM_I2C_NXP_TDA998X=y
CONFIG_DRM_STARFIVE=y
CONFIG_FB=y
# CONFIG_VGA_CONSOLE is not set
# CONFIG_USB_SUPPORT is not set
CONFIG_DMABUF_HEAPS=y
CONFIG_DMABUF_HEAPS_SYSTEM=y
# CONFIG_VIRTIO_MENU is not set
# CONFIG_VHOST_MENU is not set
# CONFIG_IOMMU_SUPPORT is not set
CONFIG_PHY_M31_DPHY_RX0=y
# CONFIG_DNOTIFY is not set
CONFIG_FANOTIFY=y
CONFIG_AUTOFS_FS=y
CONFIG_OVERLAY_FS=y
CONFIG_OVERLAY_FS_INDEX=y
CONFIG_OVERLAY_FS_XINO_AUTO=y
CONFIG_OVERLAY_FS_METACOPY=y
CONFIG_PROC_KCORE=y
CONFIG_TMPFS=y
CONFIG_TMPFS_POSIX_ACL=y
CONFIG_EFIVAR_FS=y
# CONFIG_MISC_FILESYSTEMS is not set
CONFIG_NLS=y
CONFIG_NLS_DEFAULT="utf8"
CONFIG_NLS_CODEPAGE_437=y
CONFIG_NLS_ISO8859_15=y
CONFIG_NLS_UTF8=y
CONFIG_LSM=""
CONFIG_CRYPTO_ECDH=y
CONFIG_CRYPTO_ECB=y
CONFIG_CRYPTO_CMAC=y
CONFIG_CRYPTO_XXHASH=y
CONFIG_CRYPTO_BLAKE2B=y
CONFIG_CRYPTO_SHA256=y
CONFIG_CRYPTO_AES=y
CONFIG_CRYPTO_ZSTD=y
CONFIG_CRYPTO_LIB_BLAKE2S=y
CONFIG_CRYPTO_LIB_CURVE25519=y
CONFIG_CRYPTO_LIB_CHACHA20POLY1305=y
# CONFIG_CRYPTO_HW is not set
CONFIG_CRC16=y
CONFIG_LIBCRC32C=y
# CONFIG_SYMBOLIC_ERRNAME is not set
CONFIG_STRIP_ASM_SYMS=y
CONFIG_DEBUG_SECTION_MISMATCH=y
# CONFIG_SECTION_MISMATCH_WARN_ONLY is not set
CONFIG_DEBUG_FS=y
# CONFIG_DEBUG_MISC is not set
CONFIG_DEBUG_RODATA_TEST=y
CONFIG_DEBUG_WX=y
CONFIG_SOFTLOCKUP_DETECTOR=y
CONFIG_WQ_WATCHDOG=y
# CONFIG_SCHED_DEBUG is not set
CONFIG_STACKTRACE=y
# CONFIG_FTRACE is not set
# CONFIG_RUNTIME_TESTING_MENU is not set
# CONFIG_CMDLINE="earlyprintk console=ttyS0,115200 debug stmmaceth=chain_mode:1"
CONFIG_CMDLINE="console=tty0 console=ttyS0,115200 earlycon debug stmmaceth=chain_mode:1 initcall_debug clk_ignore_unused"
CONFIG_CMDLINE_FORCE=y
```
